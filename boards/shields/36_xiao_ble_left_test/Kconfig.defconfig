## boards/shields/36_xiao_ble_left_test/Kconfig.defconfig
```kconfig
if SHIELD_36_XIAO_BLE_LEFT_TEST

config ZMK_KEYBOARD_NAME
    default "36 left test"

endif
```

## boards/shields/36_xiao_ble_left_test/Kconfig.shield
```kconfig
config SHIELD_36_XIAO_BLE_LEFT_TEST
    def_bool $(shields_list_contains,36_xiao_ble_left_test)
```
